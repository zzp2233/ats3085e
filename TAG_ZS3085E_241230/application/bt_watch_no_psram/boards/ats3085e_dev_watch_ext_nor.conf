## TAG_ZS3085E_241230/application/bt_watch_no_psram/boards/ats3085e_dev_watch_ext_nor.conf
```kconfig
#=========== config for boards ===========
CONFIG_DSP_IMAGE_PATH="/NOR:K/"

CONFIG_LV_VDB_SIZE=36348
CONFIG_UI_GUI_MEM_POOL_SIZE=391216
CONFIG_UI_RES_MEM_POOL_SIZE=0
#CONFIG_BITMAP_PER_FONT_CACHE_SIZE=16552
CONFIG_BITMAP_FONT_CACHE_POOL_SIZE=0
CONFIG_FREETYPE_FONT_BITMAP_BPP=2
CONFIG_FREETYPE_PER_FONT_CACHE_SIZE=24576
CONFIG_FREETYPE_FONT_ENABLE_MEMORY_FACE=y
CONFIG_FREETYPE_FONT_MAX_FACES=2
CONFIG_FREETYPE_FONT_MAX_SIZES=3
CONFIG_FREETYPE_FONT_SHAPE_CACHE_SIZE=0

CONFIG_TILE_CACHE_NUM=2
CONFIG_TILE_BYTES_PER_PIXELS=3
CONFIG_TILE_MAX_H=78
CONFIG_TILE_MAX_W=78
CONFIG_LVGL_DECODE_CACHE_BUF_SIZE=90870

CONFIG_OTA_TEMP_PART_DEV_NAME="spi_flash"

#usb mass storage config
CONFIG_MASS_STORAGE_DISK_PDRV=0
CONFIG_MASS_STORAGE_DISK_NAME="NOR"

CONFIG_SPINAND_ACTS=n
CONFIG_SPINAND_LIB=n

CONFIG_DISK_ACCESS_NOR=y
CONFIG_APP_UI_DISK="/NOR:A"
CONFIG_APP_FONT_DISK="/NOR:C"
CONFIG_APP_FAT_DISK="/NOR:"
CONFIG_APP_UI_DISK_B="/NOR:B"
CONFIG_WELCOME_UI_DISK="/NOR:K"

CONFIG_MASS_STORAGE_BUF_SIZE=4096

CONFIG_IPMSG_BTC_FCC_NAME="/NOR:K/fcc.bin"
CONFIG_IPMSG_BTC_SRRC_NAME="/NOR:K/srrc.bin"

CONFIG_USER_WORK_Q=y
CONFIG_USER_WORK_Q_PRIORITY=8

CONFIG_LVGL_USE_IMG_DECODER_ACTS=y
```

## TAG_ZS3085E_241230/application/bt_watch_no_psram/testcase.yaml
```yaml
sample:
  description: bt watch no psram application
    application
  name: bt_watch

common:
    tags: integration
    integration_platforms:
      - ats3085l_dvb_watch_ext_nor_max
      - ats3085e_dvb_watch_ext_nor_max

    harness: console
    harness_config:
      type: one_line
      regex:
        - "system ready ! (.*)"
tests:
  bt_watch.full:
    tags: integration

  bt_watch.no_bt_call:
    platform_allow: ats3085l_dvb_watch_ext_nor_max
    extra_args: CONF_FILE=prj_no_btcall.conf

  bt_watch.no_bt_music:
    platform_allow: ats3085l_dvb_watch_ext_nor_max
    extra_args: CONF_FILE=prj_no_bt_music.conf

  bt_watch.no_local_music:
    platform_allow: ats3085l_dvb_watch_ext_nor_max
    extra_args: CONF_FILE=prj_no_local_music.conf

  bt_watch.no_media:
    platform_allow: ats3085l_dvb_watch_ext_nor_max
    extra_args: CONF_FILE=prj_no_media.conf

  bt_watch.no_ui:
    platform_allow: ats3085l_dvb_watch_ext_nor_max
    extra_args: CONF_FILE=prj_no_ui.conf
```

## TAG_ZS3085E_241230/thirdparty/lib/glyphix/Kconfig
```kconfig
# SPDX-License-Identifier: Apache-2.0

menuconfig GLYPHIX
	bool "Glyphix 3rd JavaScript Application Runtime Library"
	help
	  This option enables the Glyphix library.

if GLYPHIX

	choice GX_SCREEN_SHAPE
			prompt "Screen shape"
			default GX_SCREEN_SHAPE_ROUND
			help
					Screen shape infomation. The application will show 
					different layout on different screen shape.
			config GX_SCREEN_SHAPE_ROUND
					bool "Round"
			config GX_SCREEN_SHAPE_RECTANGLE
					bool "Rectangle"
	endchoice

	config GX_SCREEN_WIDTH
			int "Screen width size"
			default 466

	if GX_SCREEN_SHAPE_RECTANGLE
			config GX_SCREEN_HEIGHT
			int "Screen height size"
			default 466
	endif #GX_SCREEN_SHAPE_RECTANGLE

	if GX_SCREEN_SHAPE_ROUND
		config GX_SCREEN_HEIGHT
				int
				default GX_SCREEN_WIDTH
				help
						"Screen height size"
	endif #GX_SCREEN_SHAPE_ROUND

endif #CONFIG_GLYPHIX
```

## TAG_ZS3085E_241230/zephyr/boards/arm/ats3085e_dev_watch_ext_nor/Kconfig.board
```kconfig
# STM32F469I-DISCO board configuration

# Copyright (c) 2016 Linaro Limited.
# SPDX-License-Identifier: Apache-2.0

config BOARD_ATS3085E_DEV_WATCH_EXT_NOR
	bool "loepard ats3085e  Development Board"
	depends on SOC_LEOPARD
```

## TAG_ZS3085E_241230/zephyr/boards/arm/ats3085e_dev_watch_ext_nor_i8/Kconfig.board
```kconfig
# STM32F469I-DISCO board configuration

# Copyright (c) 2016 Linaro Limited.
# SPDX-License-Identifier: Apache-2.0

config BOARD_ATS3085E_DEV_WATCH_EXT_NOR_INDEX8
	bool "loepard ats3085e index8 Development Board"
	depends on SOC_LEOPARD
```

## TAG_ZS3085E_241230/zephyr/west.yml
```yaml
manifest:
  projects:
  - name: cmsis
    url: ssh://192.168.4.4:29418/ZH/actions/ZSDK_HAL_CMSIS
    revision: b0612c97c1401feeb4160add6462c3627fe90fc7
    path: thirdparty/hal/cmsis
  - name: fatfs
    url: ssh://192.168.4.4:29418/ZH/actions/ZSDK_FS_FATFS
    revision: BF1__TAG_ZS3085E_2700_240124
    path: thirdparty/fs/fatfs
  - name: lvgl
    url: ssh://192.168.4.4:29418/ZH/actions/ZSDK_LIB_LVGL
    revision: BF1__TAG_ZS3085E_2700_240124
    path: thirdparty/lib/gui/lvgl
  - name: alipay
    url: ssh://192.168.4.4:29418/ZH/actions/ZSDK_LIB_ALIPAY
    revision: ZS308B_dev_v2.7
    path: thirdparty/lib/alipay
  - name: alipay_wxpay
    url: ssh://192.168.4.4:29418/ZH/actions/ZSDK_LIB_ALIPAY_WXPAY
    revision: ZS308B_dev_v2.7
    path: thirdparty/lib/alipay_wxpay
  - name: mbedtls
    url: ssh://192.168.4.4:29418/ZH/actions/ZSDK_CRYPTO_MBEDTLS
    revision: 5765cb7f75a9973ae9232d438e361a9d7bbc49e7
    path: thirdparty/crypto/mbedtls
  - name: segger
    url: ssh://192.168.4.4:29418/ZH/actions/ZSDK_DBG_SEGGER
    revision: 3a52ab222133193802d3c3b4d21730b9b1f1d2f6
    path: thirdparty/debug/segger
  - name: tinycrypt
    url: ssh://192.168.4.4:29418/ZH/actions/ZSDK_CRYPTO_TINYCRYPT
    revision: 9bdf43334d57a4c982acba7586336e69faeecc1a
    path: thirdparty/crypto/tinycrypt
  - name: littlefs
    url: ssh://192.168.4.4:29418/ZH/actions/ZSDK_FS_LITTLEFS
    revision: 9e4498d1c73009acd84bb36036ee5e2869112a6c
    path: thirdparty/fs/littlefs
  - name: bootloader
    url: ssh://192.168.4.4:29418/ZH/actions/ZSDK_BOOT_LOADER
    revision: BF1__TAG_ZS3085E_2700_240124
  - name: framework_base
    url: ssh://192.168.4.4:29418/ZH/actions/ZSDK_LIB_FRAMEWORK_BASE
    revision: BF1__TAG_ZS3085E_2700_240124
    path: framework/base
  - name: framework_system
    url: ssh://192.168.4.4:29418/ZH/actions/ZSDK_LIB_SYSTEM
    revision: BF1__TAG_ZS3085E_2700_240124
    path: framework/system
  - name: audio
    url: ssh://192.168.4.4:29418/ZH/actions/ZSDK_LIB_AUDIO
    revision: BF1__TAG_ZS3085E_2700_240124
    path: framework/audio
  - name: media
    url: ssh://192.168.4.4:29418/ZH/actions/ZSDK_LIB_MEDIA_BASE
    revision: BF1__TAG_ZS3085E_2700_240124
    path: framework/media
  - name: ota
    url: ssh://192.168.4.4:29418/ZH/actions/ZSDK_LIB_OTA
    revision: BF1__TAG_ZS3085E_2700_240124
    path: framework/ota
  - name: bluetooth
    url: ssh://192.168.4.4:29418/ZH/actions/ZSDK_LIB_BLUETOOTH
    revision: BF1__TAG_ZS3085E_2700_240124
    path: framework/bluetooth
  - name: display
    url: ssh://192.168.4.4:29418/ZH/actions/ZSDK_LIB_DISPLAY
    revision: BF1__TAG_ZS3085E_2700_240124
    path: framework/display
  - name: usb
    url: ssh://192.168.4.4:29418/ZH/actions/ZSDK_LIB_USB
    revision: BF1__TAG_ZS3085E_2700_240124
    path: framework/usb
  - name: sensor
    url: ssh://192.168.4.4:29418/ZH/actions/ZSDK_LIB_SENSOR
    revision: BF1__TAG_ZS3085E_2700_240124
    path: framework/sensor
  - name: bt_watch_no_psram
    url: ssh://192.168.4.4:29418/ZH/actions/BT_WATCH_NO_PSRAM
    revision: BF1__TAG_ZS3085E_2700_240124
    path: application/bt_watch_no_psram
  - name: app_demo
    url: ssh://192.168.4.4:29418/ZH/actions/ZSDK_APPLICATION_DEMO
    revision: BF1__TAG_ZS3085E_2700_240124
    path: application/app_demo
  self:
    path: zephyr
    west-commands: scripts/west-commands.yml
```
